// ATtiny85 grain player
#include <avr/io.h>
#include <avr/interrupt.h>
#include <avr/pgmspace.h>

#define F_CPU 8000000UL
#define MS_TO_NOP(ms) (((F_CPU / 1000) * ms) / 6 ) - 4000 // approximation

// raw headerless unsigned 8 bit PCM data 
const uint8_t chirp[] PROGMEM = {
0x80, 0xA4, 0x39, 0xE2, 0x09, 0xFF, 0x03, 0xEE, 0x2A, 0xB4, 0x72, 0x64, 0xC1, 0x1F, 0xF6, 0x00, 
0xFB, 0x16, 0xCB, 0x5B, 0x79, 0xB1, 0x29, 0xF1, 0x01, 0xFC, 0x15, 0xCA, 0x5E, 0x73, 0xB9, 0x20, 
0xF7, 0x00, 0xF6, 0x24, 0xB3, 0x7C, 0x53, 0xD6, 0x0B, 0xFF, 0x08, 0xDC, 0x4D, 0x80, 0xB2, 0x22, 
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0x13, 0x11, 0x0F, 0x0D, 0x0C, 0x0A, 0x09, 0x08
};

// ring buffer
volatile uint8_t ringCount = 0; // number of entries in ringbuffer
volatile uint8_t ringRead = 0;  // read position
uint8_t ringWrite = 0;          // write position
uint8_t ringbuffer[256];        // ringbuffer
uint16_t samplePosition = 0;    // sample position

uint16_t lfsr = 0xACE1;         // pseudo random number generator seed

bool triggered = false;         // button pressed flag
bool foldWave = false;          // fold wave flag
bool lofi = false;              // lofi flag
uint16_t positionValue = 0;     // sample position value

uint16_t adcSizeValue = 0;      // ADC size value
uint8_t adcFoldValue = 0;       // ADC fold value

// function prototypes
void playSampleFromPosition(uint16_t, uint16_t);
uint16_t pseudoRandom();
void writeRingBuffer(uint8_t);
void resetRingBuffer();
uint8_t readSample(uint16_t);
uint16_t map(uint16_t, uint16_t, uint16_t, uint16_t, uint16_t);


void setup() {
    /* -------- PWM setup -------- */
    DDRB |= (1 << DDB1); // Enable PWM output pin PB1
    PLLCSR = (1 << PCKE) | (1 << PLLE);
    TCCR1 = (1 << PWM1A) | (2 << COM1A0) | (1 << CS10); // PWM A, clear on match, 1:1 prescale

    /* -------- Timer0 setup -------- */
    TCCR0A = (3 << WGM00); // Fast PWM
    TCCR0B = (1 << WGM02) | (2 << CS00); // 1/8 prescale
    TIMSK = (1 << OCIE0A); // Enable compare match, disable overflow
    OCR0A = 49;

    /* -------- Digital input setup -------- */
    DDRB &= ~(1 << DDB2); // trigger PB2
    DDRB &= ~(1 << DDB3); // fold PB3
    DDRB &= ~(1 << DDB0); // lofi PB0

    /* -------- ADC setup -------- */
    // ADC continously running in background, no interrupt, PB4 (ADC2) 
    DDRB    &= ~(1 << DDB4); // Set PB4 as input
    DIDR0   |= (1 << ADC2D); // Disable digital input on ADC2
    ADMUX   |= (1 << MUX1);  // Select ADC2 
    ADMUX   |= (1 << ADLAR); // Left adjust ADC result to allow easy 8 bit reading
    ADCSRA  |= (1 << ADEN)   // Enable ADC
            | (1 << ADPS2)   // Prescaler 128
            | (1 << ADPS1);  // Enable ADC, start conversion, prescaler 128
    ADCSRA  |= (1 << ADSC);  // Start conversion

    sei(); // Enable global interrupts
}

int main() {
    setup();

    while (true)
    {
        // if trigger is high
        if((PINB & (1<<PINB2)) && triggered == false) { // if trigger is pressed
            triggered = true;               // set button pressed flag
            positionValue = pseudoRandom(); // generate random number

            
            if (!(ADCSRA & (1 << ADSC)))
            {
                uint8_t low = ADCL;
                uint8_t high = ADCH;
                adcSizeValue =  (high << 8) | low;
                ADCSRA |= (1 << ADSC);
            }

            foldWave = (PINB & (1<<PINB3)); // read fold setting
            lofi = (PINB & (1<<PINB0));     // read LoFi setting

            static bool prev_lofi = !lofi;  // Initialize to the opposite of lofi so the register is set on the first run
            if(prev_lofi != lofi){
                if(lofi){
                    TCCR0B = 1<<WGM02 | 3<<CS00; // prescaler = 1/64
                }else{
                    TCCR0B = 1<<WGM02 | 2<<CS00; // prescaler = 1/8
                }
                prev_lofi = lofi; // Update the previous state
            }

            // play the sample
            playSampleFromPosition(positionValue, adcSizeValue); // play sample
        }

        // if trigger is released
        if(!(PINB & (1<<PINB2))) { 
            triggered = false;
        }   
    }
}

// Pseudo random number generator
uint16_t pseudoRandom() {
    lfsr = (lfsr >> 1) ^ (-(lfsr & 1u) & 0xB400u);
    return lfsr % 5001;  // Generate a random number between 0 and 5000
}

void writeRingBuffer(uint8_t sampleValue) {
    while (ringCount >= 128){};             // wait until there is space in ringbuffer (filled by ISR)
    ringbuffer[ringWrite++] = sampleValue;  // write sample to ringbuffer
    ringCount++;                            // increment ringbuffer data count
}

void resetRingBuffer() {
    ringRead = 0;
    ringWrite = 0;
    ringCount = 0;
}

uint8_t readSample(uint16_t position) {
    return pgm_read_byte_near(chirp + position);
}

void playSampleFromPosition(uint16_t startPosition, uint16_t endPosition) {
    uint16_t sampleSize = endPosition;
    
    for (uint16_t i = 0; i < sampleSize; i++) {
        if (startPosition < sizeof(chirp)) // if position is within sample size
        {
            uint8_t sampleValue = pgm_read_byte_near(chirp + startPosition); // read next sample value from PROGMEM

            // fold effect
            if(foldWave){
                sampleValue = (128 - sampleValue) * 2; // invert the sample value
            }
            
            sampleSize--;
            if (sampleSize <= 0 || !(PINB & (1<<PINB2))) // if trigger is released or sample is finished playing
            {
                break; // stop playing sample
            }
            startPosition++;
            writeRingBuffer(sampleValue);
        }
    }
    resetRingBuffer();
}

uint16_t map(uint16_t x, uint16_t in_min, uint16_t in_max, uint16_t out_min, uint16_t out_max) {
    return (x - in_min) * (out_max - out_min) / (in_max - in_min) + out_min;
}

// This is the interrupt service routine for Timer0 compare match A
// The purpose of this ISR is to output the samples from the ringbuffer to the PWM
ISR(TIMER0_COMPA_vect) {    
    if (ringCount) {                             //If entry in FIFO
      OCR1A = ringbuffer[(ringRead++)];          //Output 8-bit DAC
      ringCount--; // decrement ringbuffer count
    }
}